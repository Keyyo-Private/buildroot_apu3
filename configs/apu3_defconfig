## configs/apu3_defconfig
```kconfig
BR2_x86_64=y
BR2_x86_jaguar=y
# BR2_UCLIBC_INSTALL_UTILS is not set
BR2_TARGET_GENERIC_HOSTNAME="KROS-BOOTMON"
BR2_TARGET_GENERIC_ISSUE="KROS BOOT MONITOR"
BR2_TARGET_GENERIC_PASSWD_SHA256=y
BR2_ENABLE_LOCALE_WHITELIST="C"
BR2_LINUX_KERNEL=y
BR2_LINUX_KERNEL_USE_CUSTOM_CONFIG=y
BR2_LINUX_KERNEL_CUSTOM_CONFIG_FILE="board/apu3/linux.config"
BR2_LINUX_KERNEL_LZMA=y
BR2_PACKAGE_KEXEC=y
BR2_PACKAGE_KEXEC_ZLIB=y
BR2_PACKAGE_CRYPTSETUP=y
BR2_PACKAGE_FLASHROM=y
# BR2_PACKAGE_LVM2_STANDARD_INSTALL is not set
BR2_PACKAGE_UTIL_LINUX_LIBBLKID=y
BR2_TARGET_ROOTFS_CPIO_LZMA=y
BR2_TARGET_ROOTFS_INITRAMFS=y
# BR2_TARGET_ROOTFS_TAR is not set
```
